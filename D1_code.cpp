#include <WiFi.h>
#include <Wire.h>
#include <Adafruit_GFX.h>
#include <Adafruit_SSD1306.h>
#include <QMC5883LCompass.h>
#include <BLEDevice.h>
#include <BLEUtils.h>
#include <BLEScan.h>
#include <BLEAdvertisedDevice.h>

#define NUM_PEERS (sizeof(peers)/sizeof(peers[0]))

#define SCREEN_WIDTH 128
#define SCREEN_HEIGHT 64
Adafruit_SSD1306 display(SCREEN_WIDTH, SCREEN_HEIGHT, &Wire, -1);

QMC5883LCompass compass;
BLEScan* pBLEScan;


const char* ssid = "Mani";
const char* password = "12345678";
WiFiServer server(12345);  // Use same port as others
const float REF_RSSI = -54.0;
const int PATH_LOSS = 3;
const int sosPin = 14;
const int motorPin = 26;

// --- Add LOGO and ARROW bitmaps here (see canvas) ---
extern const unsigned char LOGOUntitled_design__1_[] = {
	0x00, 0x00, 0x00, 0x00, 0x00, 0x00, 0x00, 0x00, 0x00, 0x00, 0x00, 0x00, 0x00, 0x00, 0x00, 0x00, 
	0x00, 0x00, 0x00, 0x00, 0x00, 0x00, 0x00, 0x00, 0x00, 0x00, 0x00, 0x00, 0x00, 0x00, 0x00, 0x00, 
	0x00, 0x00, 0x00, 0x00, 0x00, 0x00, 0x00, 0x00, 0x00, 0x00, 0x00, 0x00, 0x00, 0x00, 0x00, 0x00, 
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	0x00, 0x00, 0x00, 0x00, 0x00, 0x00, 0x00, 0x00, 0x00, 0x00, 0x00, 0x00, 0x00, 0x00, 0x00, 0x00
};

extern const unsigned char epd_bitmap_up[]= {
	0x00, 0x00, 0x00, 0x00, 0x00, 0x01, 0x80, 0x00, 0x00, 0x03, 0xc0, 0x00, 0x00, 0x07, 0xe0, 0x00, 
	0x00, 0x0f, 0xf0, 0x00, 0x00, 0x1f, 0xf8, 0x00, 0x00, 0x3f, 0xfc, 0x00, 0x00, 0x7f, 0xfe, 0x00, 
	0x00, 0xff, 0xff, 0x00, 0x01, 0xff, 0xff, 0x80, 0x03, 0xff, 0xff, 0xc0, 0x07, 0xff, 0xff, 0xe0, 
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	0x00, 0x7f, 0xfe, 0x00, 0x00, 0x7f, 0xfe, 0x00
};

extern const unsigned char epd_bitmap_down[]= {
	0x00, 0x7f, 0xfe, 0x00, 0x00, 0x7f, 0xfe, 0x00, 0x00, 0x7f, 0xfe, 0x00, 0x00, 0x7f, 0xfe, 0x00, 
	0x00, 0x7f, 0xfe, 0x00, 0x00, 0x7f, 0xfe, 0x00, 0x00, 0x7f, 0xfe, 0x00, 0x00, 0x7f, 0xfe, 0x00, 
	0x00, 0x7f, 0xfe, 0x00, 0x00, 0x7f, 0xfe, 0x00, 0x00, 0x7f, 0xfe, 0x00, 0x00, 0x7f, 0xfe, 0x00, 
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	0x00, 0x01, 0x80, 0x00, 0x00, 0x00, 0x00, 0x00
};

extern const unsigned char epd_bitmap_left[]= {
	0x00, 0x00, 0x00, 0x00, 0x00, 0x01, 0x00, 0x00, 0x00, 0x03, 0x00, 0x00, 0x00, 0x07, 0x00, 0x00, 
	0x00, 0x0f, 0x00, 0x00, 0x00, 0x1f, 0x00, 0x00, 0x00, 0x3f, 0x00, 0x00, 0x00, 0x7f, 0x00, 0x00, 
	0x00, 0xff, 0xff, 0xfe, 0x01, 0xff, 0xff, 0xfe, 0x03, 0xff, 0xff, 0xfe, 0x07, 0xff, 0xff, 0xfe, 
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	0x00, 0x01, 0x00, 0x00, 0x00, 0x00, 0x00, 0x00
};

extern const unsigned char epd_bitmap_right[] = {
	0x00, 0x00, 0x00, 0x00, 0x00, 0x00, 0x80, 0x00, 0x00, 0x00, 0xc0, 0x00, 0x00, 0x00, 0xe0, 0x00, 
	0x00, 0x00, 0xf0, 0x00, 0x00, 0x00, 0xf8, 0x00, 0x00, 0x00, 0xfc, 0x00, 0x00, 0x00, 0xfe, 0x00, 
	0x7f, 0xff, 0xff, 0x00, 0x7f, 0xff, 0xff, 0x80, 0x7f, 0xff, 0xff, 0xc0, 0x7f, 0xff, 0xff, 0xe0, 
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	0x00, 0x00, 0x80, 0x00, 0x00, 0x00, 0x00, 0x00
};

extern const unsigned char epd_bitmap_up_right[]= {
	0x0f, 0xff, 0xff, 0xfe, 0x0f, 0xff, 0xff, 0xfe, 0x0f, 0xff, 0xff, 0xfe, 0x0f, 0xff, 0xff, 0xfe, 
	0x0f, 0xff, 0xff, 0xfe, 0x0f, 0xff, 0xff, 0xfe, 0x0f, 0xff, 0xff, 0xfe, 0x0f, 0xff, 0xff, 0xfe, 
	0x00, 0x00, 0x7f, 0xfe, 0x00, 0x00, 0xff, 0xfe, 0x00, 0x01, 0xff, 0xfe, 0x00, 0x03, 0xff, 0xfe, 
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	0x07, 0x00, 0x00, 0x00, 0x02, 0x00, 0x00, 0x00
};

extern const unsigned char epd_bitmap_down_right[]= {
	0x02, 0x00, 0x00, 0x00, 0x07, 0x00, 0x00, 0x00, 0x0f, 0x80, 0x00, 0x00, 0x1f, 0xc0, 0x01, 0xfe, 
	0x3f, 0xe0, 0x01, 0xfe, 0x7f, 0xf0, 0x01, 0xfe, 0x3f, 0xf8, 0x01, 0xfe, 0x1f, 0xfc, 0x01, 0xfe, 
	0x0f, 0xfe, 0x01, 0xfe, 0x07, 0xff, 0x01, 0xfe, 0x03, 0xff, 0x81, 0xfe, 0x01, 0xff, 0xc1, 0xfe, 
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	0x0f, 0xff, 0xff, 0xfe, 0x0f, 0xff, 0xff, 0xfe
};

extern const unsigned char epd_bitmap_up_left[]= {
	0x7f, 0xff, 0xff, 0xf0, 0x7f, 0xff, 0xff, 0xf0, 0x7f, 0xff, 0xff, 0xf0, 0x7f, 0xff, 0xff, 0xf0, 
	0x7f, 0xff, 0xff, 0xf0, 0x7f, 0xff, 0xff, 0xf0, 0x7f, 0xff, 0xff, 0xf0, 0x7f, 0xff, 0xff, 0xf0, 
	0x7f, 0xfe, 0x00, 0x00, 0x7f, 0xff, 0x00, 0x00, 0x7f, 0xff, 0x80, 0x00, 0x7f, 0xff, 0xc0, 0x00, 
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	0x00, 0x00, 0x00, 0xe0, 0x00, 0x00, 0x00, 0x40
};

extern const unsigned char epd_bitmap_down_left[]= {
	0x00, 0x00, 0x00, 0x40, 0x00, 0x00, 0x00, 0xe0, 0x00, 0x00, 0x01, 0xf0, 0x7f, 0x80, 0x03, 0xf8, 
	0x7f, 0x80, 0x07, 0xfc, 0x7f, 0x80, 0x0f, 0xfe, 0x7f, 0x80, 0x1f, 0xfc, 0x7f, 0x80, 0x3f, 0xf8, 
	0x7f, 0x80, 0x7f, 0xf0, 0x7f, 0x80, 0xff, 0xe0, 0x7f, 0x81, 0xff, 0xc0, 0x7f, 0x83, 0xff, 0x80, 
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	0x7f, 0xff, 0xff, 0xf0, 0x7f, 0xff, 0xff, 0xf0
};

extern const unsigned char epd_bitmap_direction_none[] = {
	0x00, 0x00, 0x00, 0x00, 0x00, 0x1f, 0xf8, 0x00, 0x00, 0x3f, 0xfc, 0x00, 0x00, 0x7f, 0xfe, 0x00, 
	0x00, 0xff, 0xff, 0x00, 0x00, 0xfc, 0x3f, 0x00, 0x01, 0xf8, 0x1f, 0x00, 0x01, 0xf0, 0x1f, 0x80, 
	0x00, 0x00, 0x1f, 0x80, 0x00, 0x00, 0x1f, 0x00, 0x00, 0x00, 0x3f, 0x00, 0x00, 0x00, 0x7f, 0x00, 
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	0x00, 0x07, 0x80, 0x00, 0x00, 0x00, 0x00, 0x00
};


const unsigned char* getArrowBitmap(float angle) {
  if (angle >= -22.5 && angle < 22.5) return epd_bitmap_up;
  else if (angle >= 22.5 && angle < 67.5) return epd_bitmap_up_right;
  else if (angle >= 67.5 && angle < 112.5) return epd_bitmap_right;
  else if (angle >= 112.5 && angle < 157.5) return epd_bitmap_down_right;
  else if (angle >= 157.5 || angle < -157.5) return epd_bitmap_down;
  else if (angle >= -157.5 && angle < -112.5) return epd_bitmap_down_left;
  else if (angle >= -112.5 && angle < -67.5) return epd_bitmap_left;
  else if (angle >= -67.5 && angle < -22.5) return epd_bitmap_up_left;
  return epd_bitmap_direction_none;
}

struct Peer {
  String name;
  String mac;
  float rssi;
  float heading;
  bool connected;
  float distance;
};

Peer peers[] = {
  {"D2", "68:25:DD:33:B2:70"},
  {"D3", "68:25:DD:32:F0:54"}, // for D1 only
  {"D4", "00:4B:12:2F:95:7C"}  // optional
};


float calcDistance(float rssi) {
  return pow(10, (REF_RSSI - rssi) / (10.0 * PATH_LOSS));
}

float normalizeAngle(float diff) {
  diff = fmod(diff, 360);
  if (diff > 180) diff -= 360;
  else if (diff < -180) diff += 360;
  return diff;
}

void alertOutOfRange(String name, float dist) {
  display.clearDisplay();
  display.setTextSize(1);
  display.setCursor(0, 0);
  display.println(name + " out of range!");
  display.setCursor(0, 20);
  display.print("Distance: ");
  display.print(dist, 1);
  display.println(" m");
  display.display();
  digitalWrite(motorPin, HIGH);
  delay(1000);
  digitalWrite(motorPin, LOW);
}

void alertSOS() {
  display.clearDisplay();
  display.setTextSize(2);
  display.setCursor(0, 20);
  display.println("!!! SOS !!!");
  display.display();
  digitalWrite(motorPin, HIGH);
  delay(1500);
  digitalWrite(motorPin, LOW);
}

void updatePeer(String mac, float rssi) {
  for (int i = 0; i < NUM_PEERS; i++) {
    if (peers[i].mac == mac) {
      peers[i].rssi = rssi;
      peers[i].distance = pow(10, (REF_RSSI - rssi) / (10 * PATH_LOSS));
    }
  }
}

class MyAdvertisedDeviceCallbacks : public BLEAdvertisedDeviceCallbacks {
  void onResult(BLEAdvertisedDevice advertisedDevice) {
    String mac = advertisedDevice.getAddress().toString().c_str();
    float rssi = advertisedDevice.getRSSI();

    // Update peer data
    updatePeer(mac, rssi);
  }
};

void parsePacket(String data) {
  data.trim();
  Serial.println("Received: " + data);

  if (data.startsWith("SOS")) {
    Serial.println("🔴 SOS Alert: " + data);
    // Trigger vibration, warning display, etc. if needed
  } else {
    // Handle normal data like "MAC,,HEADING"
    int firstComma = data.indexOf(',');
    int lastComma = data.lastIndexOf(',');
    
    if (firstComma > 0 && lastComma > firstComma) {
      String mac = data.substring(0, firstComma);
      String headingStr = data.substring(lastComma + 1);
      int heading = headingStr.toInt();
      
      Serial.println("From: " + mac + " | Heading: " + String(heading));
      // Add logic to update UI or peer list if needed
    }
  }
}


void setup() {
  Serial.begin(115200);

  server.begin();
  Serial.println("TCP Server started");

  

  Wire.begin(21, 22);
  compass.init();
  pinMode(sosPin, INPUT_PULLUP);
  pinMode(motorPin, OUTPUT);

  if (!display.begin(SSD1306_SWITCHCAPVCC, 0x3C)) {
    Serial.println("OLED fail");
    while (true);
  }
  display.clearDisplay();
  display.drawBitmap(0, 0, LOGOUntitled_design__1_, 128, 64, SSD1306_WHITE);
  display.display();
  delay(2000);

  pBLEScan = BLEDevice::getScan();
  pBLEScan->setAdvertisedDeviceCallbacks(new MyAdvertisedDeviceCallbacks());
  pBLEScan->setActiveScan(true);
  pBLEScan->start(5, false);


  display.clearDisplay();
  display.setTextSize(1);
  display.setCursor(0, 0);
  display.println("Connecting WiFi...");
  display.display();


  WiFi.begin(ssid, password);
  while (WiFi.status() != WL_CONNECTED) {
    delay(500); Serial.print(".");
  }
  server.begin();
  Serial.println("TCP Server started");

  display.clearDisplay();
  display.setCursor(0, 0);
  display.print("IP: ");
  display.println(WiFi.localIP());
  display.display();

  BLEDevice::init("");
  pBLEScan = BLEDevice::getScan();
  pBLEScan->setActiveScan(true);
}

// IMPROVED loop() function for D1
void loop() {
  // --- Part 1: Handle Incoming WiFi Data ---
  WiFiClient client = server.available();
  if (client) {
    while (client.connected()) {
      while (client.available()) {
        String data = client.readStringUntil('\n');
        parsePacket(data); // Process data from D2, D3, or D4

        // Send this device's (D1's) heading back to the client
        compass.read();
        client.print(String(compass.getAzimuth()) + "\n");
      }
    }
    client.stop();
  }

  // --- Part 2: Collect Data from All Peers via BLE ---
  // Perform a single, short BLE scan to find all nearby devices
  BLEScanResults foundDevices = pBLEScan->start(1, false); 

  // Iterate through the list of known peers
  for (int i = 0; i < NUM_PEERS; i++) {
    peers[i].connected = false; // Assume not connected until found

    // Check the scan results for a matching MAC address
    for (int j = 0; j < foundDevices.getCount(); j++) {
      BLEAdvertisedDevice d = foundDevices.getDevice(j);
      if (String(d.getAddress().toString().c_str()) == peers[i].mac) {
        peers[i].rssi = d.getRSSI();
        peers[i].distance = calcDistance(peers[i].rssi);
        peers[i].connected = true; 
        // NOTE: The peer's heading is updated via WiFi in parsePacket()
        break; // Found the peer, no need to check further
      }
    }
  }

  // --- Part 3: Update Display and Check Alerts for Each Peer ---
  float selfHeading = compass.getAzimuth(); // Get self heading once

  for (int i = 0; i < NUM_PEERS; i++) {
    display.clearDisplay();
    if (peers[i].connected) {
      float diff = normalizeAngle(peers[i].heading - selfHeading);
      const unsigned char* arrow = getArrowBitmap(diff);

      display.setTextSize(1);
      display.setCursor(0, 0);
      display.println(peers[i].name);
      display.setTextSize(2);
      display.setCursor(0, 20);
      display.print(peers[i].distance, 1);
      display.print(" m");
      display.drawBitmap(86, 18, arrow, 32, 30, SSD1306_WHITE);

      // Check distance threshold for alerts
      float threshold = (peers[i].name == "D2") ? 6.0 : 4.0; // Example thresholds
      if (peers[i].distance > threshold) {
        alertOutOfRange(peers[i].name, peers[i].distance);
      }
    } else {
      // Display "not found" message if peer is not connected
      display.setCursor(0, 0);
      display.println(peers[i].name + " not found");
    }
    display.display();
    delay(1500); // Delay between showing each peer's status
  }

  // --- Part 4: Check for SOS Button Press ---
  if (digitalRead(sosPin) == LOW) {
    alertSOS();
  }
}
