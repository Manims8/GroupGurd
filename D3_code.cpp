#include <WiFi.h>
#include <Wire.h>
#include <Adafruit_GFX.h>
#include <Adafruit_SSD1306.h>
#include <QMC5883LCompass.h>
#include <BLEDevice.h>
#include <BLEUtils.h>
#include <BLEScan.h>
#include <BLEAdvertisedDevice.h>

#define SCREEN_WIDTH 128
#define SCREEN_HEIGHT 64
Adafruit_SSD1306 display(SCREEN_WIDTH, SCREEN_HEIGHT, &Wire, -1);

QMC5883LCompass compass;
BLEScan* pBLEScan;

// WiFi Configuration
const char* ssid = "Mani";
const char* password = "12345678";
const uint16_t port = 12345;        // D1's TCP port
IPAddress D1_IP(192, 168, 15, 201); // UPDATE WITH D1's ACTUAL IP

// BLE Configuration
const float REF_RSSI = -54.0;
const int PATH_LOSS = 3;
const int sosPin = 14;
const int motorPin = 26;

// Peer Devices
struct Peer {
  String name;
  String mac;
  float rssi;
  float heading;
  bool connected;
  float distance;
};

Peer peers[] = {
  {"D1", "68:25:DD:33:B2:70"},   // D1 MAC
  {"D4", "00:4B:12:2F:95:7C"}    // D4 MAC
};

// Include all bitmap definitions here (same as in head_code.txt)
// [Bitmap definitions from head_code.txt go here]
extern const unsigned char LOGOUntitled_design__1_[] = {
	0x00, 0x00, 0x00, 0x00, 0x00, 0x00, 0x00, 0x00, 0x00, 0x00, 0x00, 0x00, 0x00, 0x00, 0x00, 0x00, 
	0x00, 0x00, 0x00, 0x00, 0x00, 0x00, 0x00, 0x00, 0x00, 0x00, 0x00, 0x00, 0x00, 0x00, 0x00, 0x00, 
	0x00, 0x00, 0x00, 0x00, 0x00, 0x00, 0x00, 0x00, 0x00, 0x00, 0x00, 0x00, 0x00, 0x00, 0x00, 0x00, 
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	0x00, 0x00, 0x00, 0x00, 0x00, 0x00, 0x00, 0x00, 0x00, 0x00, 0x00, 0x00, 0x00, 0x00, 0x00, 0x00
};

extern const unsigned char epd_bitmap_up[]= {
	0x00, 0x00, 0x00, 0x00, 0x00, 0x01, 0x80, 0x00, 0x00, 0x03, 0xc0, 0x00, 0x00, 0x07, 0xe0, 0x00, 
	0x00, 0x0f, 0xf0, 0x00, 0x00, 0x1f, 0xf8, 0x00, 0x00, 0x3f, 0xfc, 0x00, 0x00, 0x7f, 0xfe, 0x00, 
	0x00, 0xff, 0xff, 0x00, 0x01, 0xff, 0xff, 0x80, 0x03, 0xff, 0xff, 0xc0, 0x07, 0xff, 0xff, 0xe0, 
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	0x00, 0x7f, 0xfe, 0x00, 0x00, 0x7f, 0xfe, 0x00
};

extern const unsigned char epd_bitmap_down[]= {
	0x00, 0x7f, 0xfe, 0x00, 0x00, 0x7f, 0xfe, 0x00, 0x00, 0x7f, 0xfe, 0x00, 0x00, 0x7f, 0xfe, 0x00, 
	0x00, 0x7f, 0xfe, 0x00, 0x00, 0x7f, 0xfe, 0x00, 0x00, 0x7f, 0xfe, 0x00, 0x00, 0x7f, 0xfe, 0x00, 
	0x00, 0x7f, 0xfe, 0x00, 0x00, 0x7f, 0xfe, 0x00, 0x00, 0x7f, 0xfe, 0x00, 0x00, 0x7f, 0xfe, 0x00, 
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	0x00, 0x01, 0x80, 0x00, 0x00, 0x00, 0x00, 0x00
};

extern const unsigned char epd_bitmap_left[]= {
	0x00, 0x00, 0x00, 0x00, 0x00, 0x01, 0x00, 0x00, 0x00, 0x03, 0x00, 0x00, 0x00, 0x07, 0x00, 0x00, 
	0x00, 0x0f, 0x00, 0x00, 0x00, 0x1f, 0x00, 0x00, 0x00, 0x3f, 0x00, 0x00, 0x00, 0x7f, 0x00, 0x00, 
	0x00, 0xff, 0xff, 0xfe, 0x01, 0xff, 0xff, 0xfe, 0x03, 0xff, 0xff, 0xfe, 0x07, 0xff, 0xff, 0xfe, 
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	0x00, 0x01, 0x00, 0x00, 0x00, 0x00, 0x00, 0x00
};

extern const unsigned char epd_bitmap_right[] = {
	0x00, 0x00, 0x00, 0x00, 0x00, 0x00, 0x80, 0x00, 0x00, 0x00, 0xc0, 0x00, 0x00, 0x00, 0xe0, 0x00, 
	0x00, 0x00, 0xf0, 0x00, 0x00, 0x00, 0xf8, 0x00, 0x00, 0x00, 0xfc, 0x00, 0x00, 0x00, 0xfe, 0x00, 
	0x7f, 0xff, 0xff, 0x00, 0x7f, 0xff, 0xff, 0x80, 0x7f, 0xff, 0xff, 0xc0, 0x7f, 0xff, 0xff, 0xe0, 
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	0x00, 0x00, 0x80, 0x00, 0x00, 0x00, 0x00, 0x00
};

extern const unsigned char epd_bitmap_up_right[]= {
	0x0f, 0xff, 0xff, 0xfe, 0x0f, 0xff, 0xff, 0xfe, 0x0f, 0xff, 0xff, 0xfe, 0x0f, 0xff, 0xff, 0xfe, 
	0x0f, 0xff, 0xff, 0xfe, 0x0f, 0xff, 0xff, 0xfe, 0x0f, 0xff, 0xff, 0xfe, 0x0f, 0xff, 0xff, 0xfe, 
	0x00, 0x00, 0x7f, 0xfe, 0x00, 0x00, 0xff, 0xfe, 0x00, 0x01, 0xff, 0xfe, 0x00, 0x03, 0xff, 0xfe, 
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	0x07, 0x00, 0x00, 0x00, 0x02, 0x00, 0x00, 0x00
};

extern const unsigned char epd_bitmap_down_right[]= {
	0x02, 0x00, 0x00, 0x00, 0x07, 0x00, 0x00, 0x00, 0x0f, 0x80, 0x00, 0x00, 0x1f, 0xc0, 0x01, 0xfe, 
	0x3f, 0xe0, 0x01, 0xfe, 0x7f, 0xf0, 0x01, 0xfe, 0x3f, 0xf8, 0x01, 0xfe, 0x1f, 0xfc, 0x01, 0xfe, 
	0x0f, 0xfe, 0x01, 0xfe, 0x07, 0xff, 0x01, 0xfe, 0x03, 0xff, 0x81, 0xfe, 0x01, 0xff, 0xc1, 0xfe, 
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	0x0f, 0xff, 0xff, 0xfe, 0x0f, 0xff, 0xff, 0xfe
};

extern const unsigned char epd_bitmap_up_left[]= {
	0x7f, 0xff, 0xff, 0xf0, 0x7f, 0xff, 0xff, 0xf0, 0x7f, 0xff, 0xff, 0xf0, 0x7f, 0xff, 0xff, 0xf0, 
	0x7f, 0xff, 0xff, 0xf0, 0x7f, 0xff, 0xff, 0xf0, 0x7f, 0xff, 0xff, 0xf0, 0x7f, 0xff, 0xff, 0xf0, 
	0x7f, 0xfe, 0x00, 0x00, 0x7f, 0xff, 0x00, 0x00, 0x7f, 0xff, 0x80, 0x00, 0x7f, 0xff, 0xc0, 0x00, 
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	0x00, 0x00, 0x00, 0xe0, 0x00, 0x00, 0x00, 0x40
};

extern const unsigned char epd_bitmap_down_left[]= {
	0x00, 0x00, 0x00, 0x40, 0x00, 0x00, 0x00, 0xe0, 0x00, 0x00, 0x01, 0xf0, 0x7f, 0x80, 0x03, 0xf8, 
	0x7f, 0x80, 0x07, 0xfc, 0x7f, 0x80, 0x0f, 0xfe, 0x7f, 0x80, 0x1f, 0xfc, 0x7f, 0x80, 0x3f, 0xf8, 
	0x7f, 0x80, 0x7f, 0xf0, 0x7f, 0x80, 0xff, 0xe0, 0x7f, 0x81, 0xff, 0xc0, 0x7f, 0x83, 0xff, 0x80, 
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	0x7f, 0xff, 0xff, 0xf0, 0x7f, 0xff, 0xff, 0xf0
};

extern const unsigned char epd_bitmap_direction_none[] = {
	0x00, 0x00, 0x00, 0x00, 0x00, 0x1f, 0xf8, 0x00, 0x00, 0x3f, 0xfc, 0x00, 0x00, 0x7f, 0xfe, 0x00, 
	0x00, 0xff, 0xff, 0x00, 0x00, 0xfc, 0x3f, 0x00, 0x01, 0xf8, 0x1f, 0x00, 0x01, 0xf0, 0x1f, 0x80, 
	0x00, 0x00, 0x1f, 0x80, 0x00, 0x00, 0x1f, 0x00, 0x00, 0x00, 0x3f, 0x00, 0x00, 0x00, 0x7f, 0x00, 
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	0x00, 0x07, 0x80, 0x00, 0x00, 0x00, 0x00, 0x00
};

float calcDistance(float rssi) {
  return pow(10, (REF_RSSI - rssi) / (10.0 * PATH_LOSS));
}

float normalizeAngle(float diff) {
  diff = fmod(diff, 360);
  if (diff > 180) diff -= 360;
  else if (diff < -180) diff += 360;
  return diff;
}

const unsigned char* getArrowBitmap(float angle) {
  if (angle >= -22.5 && angle < 22.5) return epd_bitmap_up;
  else if (angle >= 22.5 && angle < 67.5) return epd_bitmap_up_right;
  else if (angle >= 67.5 && angle < 112.5) return epd_bitmap_right;
  else if (angle >= 112.5 && angle < 157.5) return epd_bitmap_down_right;
  else if (angle >= 157.5 || angle < -157.5) return epd_bitmap_down;
  else if (angle >= -157.5 && angle < -112.5) return epd_bitmap_down_left;
  else if (angle >= -112.5 && angle < -67.5) return epd_bitmap_left;
  else if (angle >= -67.5 && angle < -22.5) return epd_bitmap_up_left;
  return epd_bitmap_direction_none;
}

void alertOutOfRange(String name, float dist) {
  display.clearDisplay();
  display.setTextSize(1);
  display.setCursor(0, 0);
  display.println(name + " out of range!");
  display.setCursor(0, 20);
  display.print("Distance: ");
  display.print(dist, 1);
  display.println(" m");
  display.display();
  digitalWrite(motorPin, HIGH);
  delay(1000);
  digitalWrite(motorPin, LOW);
}

void alertSOS() {
  display.clearDisplay();
  display.setTextSize(2);
  display.setCursor(0, 20);
  display.println("!!! SOS !!!");
  display.display();
  digitalWrite(motorPin, HIGH);
  delay(1500);
  digitalWrite(motorPin, LOW);
}

WiFiClient client;

void setup() {
  Serial.begin(115200);
  Wire.begin(21, 22);
  compass.init();
  pinMode(sosPin, INPUT_PULLUP);
  pinMode(motorPin, OUTPUT);

  // Initialize OLED
  if (!display.begin(SSD1306_SWITCHCAPVCC, 0x3C)) {
    Serial.println("OLED fail");
    while (true);
  }
  
  // Show boot logo
  display.clearDisplay();
  display.drawBitmap(0, 0, LOGOUntitled_design__1_, 128, 64, SSD1306_WHITE);
  display.display();
  delay(2000);

  // Connect to WiFi
  display.clearDisplay();
  display.setTextSize(1);
  display.setCursor(0, 0);
  display.println("Connecting WiFi...");
  display.display();
  
  WiFi.begin(ssid, password);
  while (WiFi.status() != WL_CONNECTED) {
    delay(500);
    Serial.print(".");
  }
  
  display.clearDisplay();
  display.setCursor(0, 0);
  display.print("IP: ");
  display.println(WiFi.localIP());
  display.display();
  delay(1000);

  // Initialize BLE scanner
  BLEDevice::init("");
  pBLEScan = BLEDevice::getScan();
  pBLEScan->setActiveScan(true);
  pBLEScan->setInterval(50);
  pBLEScan->setWindow(49);
}

void loop() {
  // 1. Check for SOS button press
  if (digitalRead(sosPin) == LOW) {
    alertSOS();
    if (client.connected()) {
      client.print("SOS," + WiFi.macAddress() + "\n");
    }
  }

  // 2. Perform BLE scan
  BLEScanResults scanResults = pBLEScan->start(1, false);
  
  // Process scan results
  for (int i = 0; i < 2; i++) { // For D1 and D4
    peers[i].connected = false;
    
    for (int j = 0; j < scanResults.getCount(); j++) {
      BLEAdvertisedDevice device = scanResults.getDevice(j);
      String deviceMac = device.getAddress().toString().c_str();
      
      if (deviceMac == peers[i].mac) {
        peers[i].rssi = device.getRSSI();
        peers[i].distance = calcDistance(peers[i].rssi);
        peers[i].connected = true;
        break;
      }
    }
  }
  pBLEScan->clearResults();

  // 3. Get self heading
  compass.read();
  int selfHeading = compass.getAzimuth();

  // 4. Connect to D1 and send data
  if (!client.connected()) {
    if (client.connect(D1_IP, port)) {
      Serial.println("Connected to D1 server");
    }
  }

  if (client.connected()) {
    String packet = WiFi.macAddress() + "," + String(selfHeading) + "\n";
    client.print(packet);
    Serial.println("Sent: " + packet);
  }

  // 5. Display peer information
  for (int i = 0; i < 2; i++) {
    if (peers[i].connected) {
      // Calculate relative direction
      float diff = normalizeAngle(peers[i].heading - selfHeading);
      const unsigned char* arrow = getArrowBitmap(diff);

      // Display on OLED
      display.clearDisplay();
      display.setTextSize(1);
      display.setCursor(0, 0);
      display.println(peers[i].name);
      display.setTextSize(2);
      display.setCursor(0, 20);
      display.print(peers[i].distance, 1);
      display.print(" m");
      display.drawBitmap(86, 18, arrow, 32, 30, SSD1306_WHITE);
      display.display();

      // Check distance thresholds
      float threshold = (peers[i].name == "D1") ? 10.0 : 4.0;
      if (peers[i].distance > threshold) {
        alertOutOfRange(peers[i].name, peers[i].distance);
      }
    } else {
      display.clearDisplay();
      display.setCursor(0, 0);
      display.println(peers[i].name + " not found");
      display.display();
    }
    delay(1000);
  }

  delay(1000); // Main loop delay
}