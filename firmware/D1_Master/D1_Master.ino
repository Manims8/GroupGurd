/*
 * =================================================================
 * D1 - MASTER DEVICE (CONTROLLER) - WI-FI VERSION (MODIFIED)
 * =================================================================
 *
 * Role:
 * 1. Hosts a TCP server to receive data from D2 & D3.
 * 2. Reads its own compass heading.
 * 3. Calculates distance via reported Wi-Fi RSSI from peripherals.
 * 4. Calculates and displays relative direction using bitmaps.
 * 5. Acts as a TCP client to send warnings to D2 & D3.
 * 6. Sends heading and distance data back to D3 for its display.
 *
 * HARDWARE: ESP32, QMC5883L, 0.96" OLED, Button, Vibration Motor
 *
 */

// LIBRARIES
#include <WiFi.h>
#include <Wire.h>
#include <QMC5883LCompass.h>
#include <Adafruit_GFX.h>
#include <Adafruit_SSD1306.h>
#include <cmath>

// =================== NETWORK CONFIGURATION ===================
const char* ssid = "GroupGuard";
const char* password = "Groupguard@0826";
IPAddress D2_IP;
IPAddress D3_IP;
IPAddress D4_IP;
const uint16_t D1_SERVER_PORT = 12345;
const uint16_t PERIPHERAL_PORT = 54321;
WiFiServer d1_server(D1_SERVER_PORT);

// =================== HARDWARE & DEVICE CONFIGURATION ===================
#define I2C_SDA 21
#define I2C_SCL 22
#define BUTTON_PIN 15
#define VIBRATION_MOTOR_PIN 5
#define SCREEN_WIDTH 128
#define SCREEN_HEIGHT 64
#define OLED_RESET -1
Adafruit_SSD1306 display(SCREEN_WIDTH, SCREEN_HEIGHT, &Wire, OLED_RESET);
QMC5883LCompass compass;

// =================== LOGO BITMAP ===================
const unsigned char logo_bitmap[] PROGMEM = {
	0x00, 0x00, 0x00, 0x00, 0x00, 0x00, 0x00, 0x00, 0x00, 0x00, 0x00, 0x00, 0x00, 0x00, 0x00, 0x00, 
	0x00, 0x00, 0x00, 0x00, 0x00, 0x00, 0x00, 0x00, 0x00, 0x00, 0x00, 0x00, 0x00, 0x00, 0x00, 0x00, 
	0x00, 0x00, 0x00, 0x00, 0x00, 0x00, 0x00, 0x00, 0x00, 0x00, 0x00, 0x00, 0x00, 0x00, 0x00, 0x00, 
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	0x00, 0x00, 0x00, 0x00, 0x00, 0x00, 0x00, 0x00, 0x00, 0x00, 0x00, 0x00, 0x00, 0x00, 0x00, 0x00
};

// =================== NEW: 32x30 ARROW BITMAPS ===================
const unsigned char epd_bitmap_up[] PROGMEM = {
	0x00, 0x00, 0x00, 0x00, 0x00, 0x01, 0x80, 0x00, 0x00, 0x03, 0xc0, 0x00, 0x00, 0x07, 0xe0, 0x00, 
	0x00, 0x0f, 0xf0, 0x00, 0x00, 0x1f, 0xf8, 0x00, 0x00, 0x3f, 0xfc, 0x00, 0x00, 0x7f, 0xfe, 0x00, 
	0x00, 0xff, 0xff, 0x00, 0x01, 0xff, 0xff, 0x80, 0x03, 0xff, 0xff, 0xc0, 0x07, 0xff, 0xff, 0xe0, 
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	0x00, 0x7f, 0xfe, 0x00, 0x00, 0x7f, 0xfe, 0x00
};

const unsigned char epd_bitmap_down[] PROGMEM = {
	0x00, 0x7f, 0xfe, 0x00, 0x00, 0x7f, 0xfe, 0x00, 0x00, 0x7f, 0xfe, 0x00, 0x00, 0x7f, 0xfe, 0x00, 
	0x00, 0x7f, 0xfe, 0x00, 0x00, 0x7f, 0xfe, 0x00, 0x00, 0x7f, 0xfe, 0x00, 0x00, 0x7f, 0xfe, 0x00, 
	0x00, 0x7f, 0xfe, 0x00, 0x00, 0x7f, 0xfe, 0x00, 0x00, 0x7f, 0xfe, 0x00, 0x00, 0x7f, 0xfe, 0x00, 
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	0x00, 0x01, 0x80, 0x00, 0x00, 0x00, 0x00, 0x00
};

const unsigned char epd_bitmap_left[] PROGMEM = {
	0x00, 0x00, 0x00, 0x00, 0x00, 0x01, 0x00, 0x00, 0x00, 0x03, 0x00, 0x00, 0x00, 0x07, 0x00, 0x00, 
	0x00, 0x0f, 0x00, 0x00, 0x00, 0x1f, 0x00, 0x00, 0x00, 0x3f, 0x00, 0x00, 0x00, 0x7f, 0x00, 0x00, 
	0x00, 0xff, 0xff, 0xfe, 0x01, 0xff, 0xff, 0xfe, 0x03, 0xff, 0xff, 0xfe, 0x07, 0xff, 0xff, 0xfe, 
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	0x00, 0x01, 0x00, 0x00, 0x00, 0x00, 0x00, 0x00
};

const unsigned char epd_bitmap_right[] PROGMEM = {
	0x00, 0x00, 0x00, 0x00, 0x00, 0x00, 0x80, 0x00, 0x00, 0x00, 0xc0, 0x00, 0x00, 0x00, 0xe0, 0x00, 
	0x00, 0x00, 0xf0, 0x00, 0x00, 0x00, 0xf8, 0x00, 0x00, 0x00, 0xfc, 0x00, 0x00, 0x00, 0xfe, 0x00, 
	0x7f, 0xff, 0xff, 0x00, 0x7f, 0xff, 0xff, 0x80, 0x7f, 0xff, 0xff, 0xc0, 0x7f, 0xff, 0xff, 0xe0, 
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	0x00, 0x00, 0x80, 0x00, 0x00, 0x00, 0x00, 0x00
};

const unsigned char epd_bitmap_up_left[] PROGMEM = {
	0x7f, 0xff, 0xff, 0xf0, 0x7f, 0xff, 0xff, 0xf0, 0x7f, 0xff, 0xff, 0xf0, 0x7f, 0xff, 0xff, 0xf0, 
	0x7f, 0xff, 0xff, 0xf0, 0x7f, 0xff, 0xff, 0xf0, 0x7f, 0xff, 0xff, 0xf0, 0x7f, 0xff, 0xff, 0xf0, 
	0x7f, 0xfe, 0x00, 0x00, 0x7f, 0xff, 0x00, 0x00, 0x7f, 0xff, 0x80, 0x00, 0x7f, 0xff, 0xc0, 0x00, 
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	0x00, 0x00, 0x00, 0xe0, 0x00, 0x00, 0x00, 0x40
};

const unsigned char epd_bitmap_up_right[] PROGMEM = {
	0x0f, 0xff, 0xff, 0xfe, 0x0f, 0xff, 0xff, 0xfe, 0x0f, 0xff, 0xff, 0xfe, 0x0f, 0xff, 0xff, 0xfe, 
	0x0f, 0xff, 0xff, 0xfe, 0x0f, 0xff, 0xff, 0xfe, 0x0f, 0xff, 0xff, 0xfe, 0x0f, 0xff, 0xff, 0xfe, 
	0x00, 0x00, 0x7f, 0xfe, 0x00, 0x00, 0xff, 0xfe, 0x00, 0x01, 0xff, 0xfe, 0x00, 0x03, 0xff, 0xfe, 
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	0x07, 0x00, 0x00, 0x00, 0x02, 0x00, 0x00, 0x00
};

const unsigned char epd_bitmap_down_left[] PROGMEM = {
	0x00, 0x00, 0x00, 0x40, 0x00, 0x00, 0x00, 0xe0, 0x00, 0x00, 0x01, 0xf0, 0x7f, 0x80, 0x03, 0xf8, 
	0x7f, 0x80, 0x07, 0xfc, 0x7f, 0x80, 0x0f, 0xfe, 0x7f, 0x80, 0x1f, 0xfc, 0x7f, 0x80, 0x3f, 0xf8, 
	0x7f, 0x80, 0x7f, 0xf0, 0x7f, 0x80, 0xff, 0xe0, 0x7f, 0x81, 0xff, 0xc0, 0x7f, 0x83, 0xff, 0x80, 
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	0x7f, 0xff, 0xff, 0xf0, 0x7f, 0xff, 0xff, 0xf0
};

const unsigned char epd_bitmap_down_right[] PROGMEM = {
	0x02, 0x00, 0x00, 0x00, 0x07, 0x00, 0x00, 0x00, 0x0f, 0x80, 0x00, 0x00, 0x1f, 0xc0, 0x01, 0xfe, 
	0x3f, 0xe0, 0x01, 0xfe, 0x7f, 0xf0, 0x01, 0xfe, 0x3f, 0xf8, 0x01, 0xfe, 0x1f, 0xfc, 0x01, 0xfe, 
	0x0f, 0xfe, 0x01, 0xfe, 0x07, 0xff, 0x01, 0xfe, 0x03, 0xff, 0x81, 0xfe, 0x01, 0xff, 0xc1, 0xfe, 
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	0x0f, 0xff, 0xff, 0xfe, 0x0f, 0xff, 0xff, 0xfe
};

const unsigned char epd_bitmap_direction_none[] PROGMEM = {
	0x00, 0x00, 0x00, 0x00, 0x00, 0x1f, 0xf8, 0x00, 0x00, 0x3f, 0xfc, 0x00, 0x00, 0x7f, 0xfe, 0x00, 
	0x00, 0xff, 0xff, 0x00, 0x00, 0xfc, 0x3f, 0x00, 0x01, 0xf8, 0x1f, 0x00, 0x01, 0xf0, 0x1f, 0x80, 
	0x00, 0x00, 0x1f, 0x80, 0x00, 0x00, 0x1f, 0x00, 0x00, 0x00, 0x3f, 0x00, 0x00, 0x00, 0x7f, 0x00, 
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	0x00, 0x07, 0x80, 0x00, 0x00, 0x00, 0x00, 0x00
};



// =================== DISTANCE & THRESHOLDS ===================
const float REF_RSSI = -45.0;
const float PATH_LOSS = 3.5;
const float D2_DISTANCE_THRESHOLD = 4.0;
const float D3_DISTANCE_THRESHOLD = 8.0;

// =================== GLOBAL VARIABLES & STATE ===================
struct DeviceState {
  String name;
  float distance = -1.0;
  int heading = -1;
  bool sos_active = false;
  unsigned long last_seen = 0;
  IPAddress ip;
};
DeviceState d2 = {"D2", -1.0, -1, false, 0};
DeviceState d3 = {"D3", -1.0, -1, false, 0};
DeviceState d4 = {"D4", -1.0, -1, false, 0};
int dir[10] = {0,0,0,0,0,0,0,0,0,0};
int hed ;
int myHeading = 0;
unsigned long lastDisplayUpdateTime = 0;
const unsigned long displayUpdateInterval = 100; // 10 FPS
bool sendingWarning = false;
bool lastButtonState = false;

// =================== UNIFIED ALERT STATE MACHINE ===================
bool alertActive = false;
unsigned long alertStartMillis = 0;
unsigned long alertDuration = 0;
unsigned long lastVibeToggle = 0;
int vibePulseOnTime = 0;
int vibePulseOffTime = 0;
bool vibePulseState = false;

// Display Page Toggling (for showing D2, D3, D4)
int displayPage = 0;
unsigned long lastPageChange = 0;

// =================== FUNCTION FORWARD DECLARATIONS ===================
void startSoftAP();
void handleIncomingData();
void sendWarning(IPAddress targetIP);
void sendDataToPeripheral(IPAddress targetIP, int heading, float distance);
void sendDataToD3(IPAddress targetIP, int heading, float distance, int d4Heading, float d4Distance, bool d4Sos, bool d4Active);
void sendDataToD4(IPAddress targetIP, int d3Heading, float d3Distance, bool d3Sos, bool d3Active);
void triggerAlert(unsigned long duration, int vibeOn, int vibeOff);
void handleAlerts();
int readCompassHeading();
void updateDisplay();
void drawSOSOverlay(const char* text);
void drawRangeWarning(const char* deviceName, float distance);
void drawPeerBox(int16_t x, int16_t y, int16_t w, int16_t h, const DeviceState &p);
const unsigned char* getArrowBitmap(float angle);
float normalizeAngle(float diff);
float calculateDistance(int rssi);

// =================== SETUP ===================
void setup() {
  Serial.begin(115200);
  Wire.begin(I2C_SDA, I2C_SCL);

  compass.init();
  pinMode(BUTTON_PIN, INPUT_PULLDOWN);
  pinMode(VIBRATION_MOTOR_PIN, OUTPUT);
  digitalWrite(VIBRATION_MOTOR_PIN, LOW);

  if (!display.begin(SSD1306_SWITCHCAPVCC, 0x3C)) {
    Serial.println(F("D1: SSD1306 allocation failed"));
    for (;;);
  }
  display.clearDisplay();
  display.drawBitmap(0, 0, logo_bitmap, 128, 64, SSD1306_WHITE);
  display.display();
  delay(2500); 

  D2_IP.fromString("192.168.86.139");
  D3_IP.fromString("192.168.86.224");
  D4_IP.fromString("192.168.86.225");
  d2.ip = D2_IP;
  d3.ip = D3_IP;
  d4.ip = D4_IP;

  startSoftAP();
  d1_server.begin();
}

// =================== MAIN LOOP ===================
void loop() {
  handleIncomingData();
  myHeading = readCompassHeading();
  handleAlerts();

  bool buttonPressed = (digitalRead(BUTTON_PIN) == HIGH);
  if (buttonPressed && !lastButtonState) {
    Serial.println("[D1] Button pressed. Sending warning...");
    sendingWarning = true;
    triggerAlert(2000, 2000, 0);

    sendWarning(D2_IP);
    sendWarning(D3_IP);
    sendWarning(D4_IP);
  }
  lastButtonState = buttonPressed;

  if (millis() - lastDisplayUpdateTime > displayUpdateInterval) {
    updateDisplay();
    lastDisplayUpdateTime = millis();
  }
}

// =================== NETWORK FUNCTIONS ===================
void startSoftAP() {
  display.clearDisplay();
  display.setTextColor(SSD1306_WHITE);
  display.setTextSize(1);
  display.setCursor(0, 0);
  display.println("D1 MASTER (SoftAP)");
  display.println("Starting SoftAP...");
  display.display();
  Serial.println("Starting SoftAP...");

  // Start ESP32 in Access Point mode
  WiFi.softAP(ssid, password);

  IPAddress myIP = WiFi.softAPIP();
  Serial.print("AP IP address: ");
  Serial.println(myIP);

  display.clearDisplay();
  display.setCursor(0, 0);
  display.println("D1 MASTER");
  display.println("Initializing...");
  display.println("IP Address:");
  display.println(myIP);
  display.display();
  delay(1500);
}

void handleIncomingData() {
  WiFiClient client = d1_server.available();
  if (client) {
    IPAddress remoteIP = client.remoteIP(); // Capture remote IP address before client.stop()
    String data = client.readStringUntil('\n');
    client.stop();
    data.trim();
    Serial.print("[D1] Received data: ");
    Serial.println(data);

    char data_cstr[64];
    data.toCharArray(data_cstr, 64);
    char* token = strtok(data_cstr, ",");

    if (token != NULL) {
      String name = token;
      DeviceState* current_device = nullptr;
      if (name == "D2") current_device = &d2;
      else if (name == "D3") current_device = &d3;
      else if (name == "D4") current_device = &d4;

      if (current_device) {
        current_device->ip = remoteIP; // Dynamically update IP address of the peer!
        bool previousSos = current_device->sos_active;
        token = strtok(NULL, ","); if (token) current_device->heading = atoi(token);
        token = strtok(NULL, ","); if (token) current_device->sos_active = (bool)atoi(token);
        token = strtok(NULL, ","); if (token) current_device->distance = calculateDistance(atoi(token));
        current_device->last_seen = millis();

        if (!previousSos && current_device->sos_active) {
            triggerAlert(3000, 300, 100);
        }

        if (name == "D3") {
            bool d4Active = (millis() - d4.last_seen < 5000);
            sendDataToD3(current_device->ip, myHeading, current_device->distance, d4.heading, d4.distance, d4.sos_active, d4Active);
        } else if (name == "D4") {
            bool d3Active = (millis() - d3.last_seen < 5000);
            sendDataToD4(current_device->ip, d3.heading, d3.distance, d3.sos_active, d3Active);
        }
      }
    }
  }
}

void sendWarning(IPAddress targetIP) {
  WiFiClient client;
  if (!client.connect(targetIP, PERIPHERAL_PORT)) {
    Serial.print("[D1] Warning connection to "); Serial.print(targetIP); Serial.println(" failed!");
    return;
  }
  client.println("WARN");
  client.stop();
  Serial.print("[D1] Warning sent to "); Serial.println(targetIP);
}

void sendDataToPeripheral(IPAddress targetIP, int heading, float distance) {
    WiFiClient client;
    if (!client.connect(targetIP, PERIPHERAL_PORT)) {
        Serial.print("[D1] Data connection to "); Serial.print(targetIP); Serial.println(" failed!");
        return;
    }
    char dataPacket[64];
    snprintf(dataPacket, sizeof(dataPacket), "D1_DATA,%d,%.2f", heading, distance);
    client.println(dataPacket);
    client.stop();
    Serial.print("[D1] Sent data packet to "); Serial.println(targetIP);
}

void sendDataToD3(IPAddress targetIP, int heading, float distance, int d4Heading, float d4Distance, bool d4Sos, bool d4Active) {
    WiFiClient client;
    if (!client.connect(targetIP, PERIPHERAL_PORT)) {
        Serial.print("[D1] Data connection to D3 failed!");
        return;
    }
    char dataPacket[64];
    snprintf(dataPacket, sizeof(dataPacket), "D1_DATA,%d,%.2f,%d,%.2f,%d,%d",
             heading, distance, d4Heading, d4Distance, d4Sos ? 1 : 0, d4Active ? 1 : 0);
    client.println(dataPacket);
    client.stop();
    Serial.print("[D1] Sent data packet to D3: "); Serial.println(dataPacket);
}

void sendDataToD4(IPAddress targetIP, int d3Heading, float d3Distance, bool d3Sos, bool d3Active) {
    WiFiClient client;
    if (!client.connect(targetIP, PERIPHERAL_PORT)) {
        Serial.print("[D1] Data connection to D4 failed!");
        return;
    }
    char dataPacket[64];
    snprintf(dataPacket, sizeof(dataPacket), "D3_DATA,%d,%.2f,%d,%d",
             d3Heading, d3Distance, d3Sos ? 1 : 0, d3Active ? 1 : 0);
    client.println(dataPacket);
    client.stop();
    Serial.print("[D1] Sent data packet to D4: "); Serial.println(dataPacket);
}

// =================== DISPLAY & HELPER FUNCTIONS ===================
void triggerAlert(unsigned long duration, int vibeOn, int vibeOff) {
    alertActive = true;
    alertStartMillis = millis();
    alertDuration = duration;
    vibePulseOnTime = vibeOn;
    vibePulseOffTime = vibeOff;
    vibePulseState = (vibeOn > 0);
    digitalWrite(VIBRATION_MOTOR_PIN, vibePulseState ? HIGH : LOW);
    lastVibeToggle = millis();
}

void handleAlerts() {
    if (!alertActive) {
        digitalWrite(VIBRATION_MOTOR_PIN, LOW);
        sendingWarning = false;
        return;
    }

    if (millis() - alertStartMillis > alertDuration) {
        alertActive = false;
        digitalWrite(VIBRATION_MOTOR_PIN, LOW);
        sendingWarning = false;
        return;
    }

    if (vibePulseOnTime > 0 && vibePulseOffTime > 0) {
        unsigned long interval = vibePulseState ? vibePulseOnTime : vibePulseOffTime;
        if (millis() - lastVibeToggle >= interval) {
            vibePulseState = !vibePulseState;
            digitalWrite(VIBRATION_MOTOR_PIN, vibePulseState ? HIGH : LOW);
            lastVibeToggle = millis();
        }
    } else {
        digitalWrite(VIBRATION_MOTOR_PIN, vibePulseOnTime > 0 ? HIGH : LOW);
    }
}

int readCompassHeading() {
  hed = 0;
  compass.read();
  for (int i = 0; i <= 9; ++i) {
    dir[i] = compass.getAzimuth();
    hed += dir[i];
  }
  return hed / 10;
}

float calculateDistance(int rssi) {
  return pow(10, (REF_RSSI - rssi) / (10.0 * PATH_LOSS));
}

void updateDisplay() {
  display.clearDisplay();
  display.setTextColor(SSD1306_WHITE);

  if (sendingWarning) {
    drawSOSOverlay("SENDING ALERT");
    display.display();
    return;
  }

  if (d2.sos_active || d3.sos_active || d4.sos_active) {
    if (d2.sos_active && d3.sos_active && d4.sos_active) drawSOSOverlay("SOS ALL");
    else {
      String sosText = "SOS";
      if (d2.sos_active) sosText += " D2";
      if (d3.sos_active) sosText += " D3";
      if (d4.sos_active) sosText += " D4";
      drawSOSOverlay(sosText.c_str());
    }
    display.display();
    return;
  }

  if (d2.distance > D2_DISTANCE_THRESHOLD && d2.last_seen > 0) {
    drawRangeWarning("D2", d2.distance);
    display.display();
    return;
  }
  if (d3.distance > D3_DISTANCE_THRESHOLD && d3.last_seen > 0) {
    drawRangeWarning("D3", d3.distance);
    display.display();
    return;
  }
  if (d4.distance > D3_DISTANCE_THRESHOLD && d4.last_seen > 0) { // Using same threshold for D4
    drawRangeWarning("D4", d4.distance);
    display.display();
    return;
  }

  // Toggle page every 3 seconds
  if (millis() - lastPageChange > 3000) {
    displayPage = (displayPage == 0) ? 1 : 0;
    lastPageChange = millis();
  }

  // NEW LAYOUT: Border and divider
  display.drawRect(0, 0, SCREEN_WIDTH, SCREEN_HEIGHT, SSD1306_WHITE);
  
  // NEW LAYOUT: Two peer boxes
  const int16_t margin = 1;
  const int16_t midX   = SCREEN_WIDTH/2;
  const int16_t boxW   = (SCREEN_WIDTH/2) - 2*margin;
  const int16_t boxH   = SCREEN_HEIGHT - 2*margin;

  if (displayPage == 0) {
    display.drawLine(SCREEN_WIDTH/2, 0, SCREEN_WIDTH/2, SCREEN_HEIGHT, SSD1306_WHITE);
    drawPeerBox(margin, margin, boxW, boxH, d2);
    drawPeerBox(midX + margin, margin, boxW, boxH, d3);
  } else {
    drawPeerBox(margin, margin, SCREEN_WIDTH - 2*margin, boxH, d4);
  }

  display.display();
}

// NEW FUNCTION: Renders content for one peer in a specific box area
void drawPeerBox(int16_t x, int16_t y, int16_t w, int16_t h, const DeviceState &p) {
    if (millis() - p.last_seen > 5000) { // Show "No Signal" if data is stale
        display.setTextSize(1);
        display.setCursor(x + 5, y + 28);
        display.println("No Signal");
        return;
    }

    // Text sizes & pixel heights
    const uint8_t nameSize = 2;
    const uint8_t distSize = 1;
    const int16_t nameH    = 8 * nameSize;
    const int16_t arrowH   = 30;
    const int16_t distH    = 8 * distSize;
    const int16_t space1   = 4; 
    const int16_t space2   = 4;

    // Total content height for vertical centering
    int16_t totalH = nameH + space1 + arrowH + space2 + distH;
    int16_t y0 = y + (h - totalH) / 2;

    // 1) Draw name centered
    display.setTextSize(nameSize);
    int16_t nameW = p.name.length() * 6 * nameSize;
    display.setCursor(x + (w - nameW) / 2, y0);
    display.print(p.name);

    // 2) Draw arrow bitmap centered
    float diff = normalizeAngle(p.heading - myHeading);
    const unsigned char* arrowBitmap = getArrowBitmap(diff);
    int16_t arrowX = x + (w - 32) / 2;
    int16_t arrowY = y0 + nameH + space1;
    display.drawBitmap(arrowX, arrowY, arrowBitmap, 32, 30, SSD1306_WHITE);

    // 3) Draw distance centered
    char buf[8];
    dtostrf(p.distance, 3, 1, buf); // Format as " 1.2" for example
    display.setTextSize(distSize);
    int16_t distW = strlen(buf) * 6 * distSize + 6; // +6 for the "m"
    int16_t distX = x + (w - distW) / 2;
    int16_t distY = arrowY + arrowH + space2;
    display.setCursor(distX, distY);
    display.print(buf);
    display.print("m");
}


void drawSOSOverlay(const char* text) {
    display.setTextSize(strlen(text) > 7 ? 1 : 3);
    // Increased blinking duration by changing divisor from 500 to 800
    if ((millis() / 2000) % 2) {
        int16_t x1, y1;
        uint16_t w, h;
        display.getTextBounds(text, 0, 0, &x1, &y1, &w, &h);
        display.setCursor((SCREEN_WIDTH - w) / 2, (SCREEN_HEIGHT - h) / 2);
        display.print(text);
    }
    display.drawRect(0, 0, SCREEN_WIDTH, SCREEN_HEIGHT, SSD1306_WHITE);
}

void drawRangeWarning(const char* deviceName, float distance) {
  display.clearDisplay();
  const int T_SIZE = 30;
  int cX = SCREEN_WIDTH / 2;
  int tTop = 5;
  display.drawTriangle(cX, tTop, cX - T_SIZE / 2, tTop + T_SIZE, cX + T_SIZE / 2, tTop + T_SIZE, SSD1306_WHITE);
  const int E_H = 12; const int E_W = 4;
  int eY = tTop + T_SIZE / 3;
  display.fillRect(cX - E_W / 2, eY, E_W, E_H, SSD1306_BLACK);
  display.fillRect(cX - E_W / 2, eY + E_H + 3, E_W, E_W, SSD1306_BLACK);
  display.setTextSize(1);
  display.setTextColor(SSD1306_WHITE);
  display.setCursor(10, tTop + T_SIZE + 10);
  display.printf("%s out of range!", deviceName);
  display.setCursor(25, tTop + T_SIZE + 22);
  display.printf("%.1f meters", distance);
}

// NEW FUNCTION: Returns correct arrow bitmap based on angle
const unsigned char* getArrowBitmap(float angle) {
  if (angle >= -22.5 && angle < 22.5) return epd_bitmap_up;
  if (angle >= 22.5 && angle < 67.5) return epd_bitmap_up_right;
  if (angle >= 67.5 && angle < 112.5) return epd_bitmap_right;
  if (angle >= 112.5 && angle < 157.5) return epd_bitmap_down_right;
  if (angle >= 157.5 || angle < -157.5) return epd_bitmap_down;
  if (angle >= -157.5 && angle < -112.5) return epd_bitmap_down_left;
  if (angle >= -112.5 && angle < -67.5) return epd_bitmap_left;
  if (angle >= -67.5 && angle < -22.5) return epd_bitmap_up_left;
  return epd_bitmap_direction_none;
}

float normalizeAngle(float diff) {
  diff = fmod(diff, 360.0);
  if (diff > 180.0) diff -= 360.0;
  else if (diff < -180.0) diff += 360.0;
  return diff;
}
