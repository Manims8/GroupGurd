/*
 * =================================================================
 * D4 - NEW PERIPHERAL DEVICE (WITH SPI DISPLAY) - WI-FI VERSION
 * =================================================================
 *
 * Role:
 * 1. Acts as a TCP client to send data to D1.
 * 2. Hosts a TCP server to listen for data and warnings from D1.
 * 3. Reads compass and sends heading, SOS status, and Wi-Fi RSSI.
 * 4. Displays its status and relative data from D1 using bitmaps.
 * 5. On warning: vibrates, blinks LED, and displays alert on SPI OLED.
 *
 * HARDWARE: ESP32, QMC5883L, 0.96" SPI OLED, Button, Vibration Motor, LED
 */

// LIBRARIES
#include <WiFi.h>
#include <Wire.h>
#include <SPI.h>
#include <QMC5883LCompass.h>
#include <Adafruit_GFX.h>
#include <Adafruit_SSD1306.h>
#include <cmath>

// =================== NETWORK CONFIGURATION ===================
const char* ssid = "GroupGuard";
const char* password = "Groupguard@0826";
IPAddress D1_SERVER_IP;
const uint16_t D1_SERVER_PORT = 12345;
const uint16_t MY_SERVER_PORT = 54321;
WiFiServer my_server(MY_SERVER_PORT);

// =================== HARDWARE & DEVICE CONFIGURATION ===================
#define I2C_SDA 21
#define I2C_SCL 22
#define BUTTON_PIN 27          // Button connected to GND (Active-Low)
#define VIBRATION_MOTOR_PIN 26 // Vibration Motor (Active-High)
#define LED_PIN 25             // LED (Active-High)
#define DEVICE_NAME "D4"

// SPI OLED PINS
#define OLED_DC    5
#define OLED_RESET 4
#define SCREEN_WIDTH 128
#define SCREEN_HEIGHT 64

// Hardware SPI used (SCK = 18, MOSI = 23)
Adafruit_SSD1306 display(SCREEN_WIDTH, SCREEN_HEIGHT, &SPI, OLED_DC, OLED_RESET, -1);
QMC5883LCompass compass;

// =================== LOGO BITMAP ===================
const unsigned char logo_bitmap[] PROGMEM = {
	0x00, 0x00, 0x00, 0x00, 0x00, 0x00, 0x00, 0x00, 0x00, 0x00, 0x00, 0x00, 0x00, 0x00, 0x00, 0x00, 
	0x00, 0x00, 0x00, 0x00, 0x00, 0x00, 0x00, 0x00, 0x00, 0x00, 0x00, 0x00, 0x00, 0x00, 0x00, 0x00, 
	0x00, 0x00, 0x00, 0x00, 0x00, 0x00, 0x00, 0x00, 0x00, 0x00, 0x00, 0x00, 0x00, 0x00, 0x00, 0x00, 
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	0x00, 0x00, 0x00, 0x00, 0x00, 0x00, 0x00, 0x00, 0x00, 0x00, 0x00, 0x00, 0x00, 0x00, 0x00, 0x00
};

// =================== NEW: 32x30 ARROW BITMAPS ===================
const unsigned char epd_bitmap_up[] PROGMEM = {
	0x00, 0x00, 0x00, 0x00, 0x00, 0x01, 0x80, 0x00, 0x00, 0x03, 0xc0, 0x00, 0x00, 0x07, 0xe0, 0x00, 
	0x00, 0x0f, 0xf0, 0x00, 0x00, 0x1f, 0xf8, 0x00, 0x00, 0x3f, 0xfc, 0x00, 0x00, 0x7f, 0xfe, 0x00, 
	0x00, 0xff, 0xff, 0x00, 0x01, 0xff, 0xff, 0x80, 0x03, 0xff, 0xff, 0xc0, 0x07, 0xff, 0xff, 0xe0, 
	0x0f, 0xff, 0xff, 0xf0, 0x1f, 0xff, 0xff, 0xf8, 0x3f, 0xff, 0xff, 0xfc, 0x00, 0x7f, 0xfe, 0x00, 
	0x00, 0x7f, 0xfe, 0x00, 0x00, 0x7f, 0xfe, 0x00, 0x00, 0x7f, 0xfe, 0x00, 0x00, 0x7f, 0xfe, 0x00, 
	0x00, 0x7f, 0xfe, 0x00, 0x00, 0x7f, 0xfe, 0x00, 0x00, 0x7f, 0xfe, 0x00, 0x00, 0x7f, 0xfe, 0x00, 
	0x00, 0x7f, 0xfe, 0x00, 0x00, 0x7f, 0xfe, 0x00, 0x00, 0x7f, 0xfe, 0x00, 0x00, 0x7f, 0xfe, 0x00, 0x00, 0x7f, 0xfe, 0x00, 0x00, 0x7f, 0xfe, 0x00
};

const unsigned char epd_bitmap_down[] PROGMEM = {
	0x00, 0x7f, 0xfe, 0x00, 0x00, 0x7f, 0xfe, 0x00, 0x00, 0x7f, 0xfe, 0x00, 0x00, 0x7f, 0xfe, 0x00, 
	0x00, 0x7f, 0xfe, 0x00, 0x00, 0x7f, 0xfe, 0x00, 0x00, 0x7f, 0xfe, 0x00, 0x00, 0x7f, 0xfe, 0x00, 
	0x00, 0x7f, 0xfe, 0x00, 0x00, 0x7f, 0xfe, 0x00, 0x00, 0x7f, 0xfe, 0x00, 0x00, 0x7f, 0xfe, 0x00, 
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	0x00, 0x01, 0x80, 0x00, 0x00, 0x00, 0x00, 0x00
};

const unsigned char epd_bitmap_left[] PROGMEM = {
	0x00, 0x00, 0x00, 0x00, 0x00, 0x01, 0x00, 0x00, 0x00, 0x03, 0x00, 0x00, 0x00, 0x07, 0x00, 0x00, 
	0x00, 0x0f, 0x00, 0x00, 0x00, 0x1f, 0x00, 0x00, 0x00, 0x3f, 0x00, 0x00, 0x00, 0x7f, 0x00, 0x00, 
	0x00, 0xff, 0xff, 0xfe, 0x01, 0xff, 0xff, 0xfe, 0x03, 0xff, 0xff, 0xfe, 0x07, 0xff, 0xff, 0xfe, 
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	0x00, 0x01, 0x00, 0x00, 0x00, 0x00, 0x00, 0x00
};

const unsigned char epd_bitmap_right[] PROGMEM = {
	0x00, 0x00, 0x00, 0x00, 0x00, 0x00, 0x80, 0x00, 0x00, 0x00, 0xc0, 0x00, 0x00, 0x00, 0xe0, 0x00, 
	0x00, 0x00, 0xf0, 0x00, 0x00, 0x00, 0xf8, 0x00, 0x00, 0x00, 0xfc, 0x00, 0x00, 0x00, 0xfe, 0x00, 
	0x7f, 0xff, 0xff, 0x00, 0x7f, 0xff, 0xff, 0x80, 0x7f, 0xff, 0xff, 0xc0, 0x7f, 0xff, 0xff, 0xe0, 
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	0x00, 0x00, 0x80, 0x00, 0x00, 0x00, 0x00, 0x00
};

const unsigned char epd_bitmap_up_left[] PROGMEM = {
	0x7f, 0xff, 0xff, 0xf0, 0x7f, 0xff, 0xff, 0xf0, 0x7f, 0xff, 0xff, 0xf0, 0x7f, 0xff, 0xff, 0xf0, 
	0x7f, 0xff, 0xff, 0xf0, 0x7f, 0xff, 0xff, 0xf0, 0x7f, 0xff, 0xff, 0xf0, 0x7f, 0xff, 0xff, 0xf0, 
	0x7f, 0xfe, 0x00, 0x00, 0x7f, 0xff, 0x00, 0x00, 0x7f, 0xff, 0x80, 0x00, 0x7f, 0xff, 0xc0, 0x00, 
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	0x00, 0x00, 0x00, 0xe0, 0x00, 0x00, 0x00, 0x40
};

const unsigned char epd_bitmap_up_right[] PROGMEM = {
	0x0f, 0xff, 0xff, 0xfe, 0x0f, 0xff, 0xff, 0xfe, 0x0f, 0xff, 0xff, 0xfe, 0x0f, 0xff, 0xff, 0xfe, 
	0x0f, 0xff, 0xff, 0xfe, 0x0f, 0xff, 0xff, 0xfe, 0x0f, 0xff, 0xff, 0xfe, 0x0f, 0xff, 0xff, 0xfe, 
	0x00, 0x00, 0x7f, 0xfe, 0x00, 0x00, 0xff, 0xfe, 0x00, 0x01, 0xff, 0xfe, 0x00, 0x03, 0xff, 0xfe, 
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	0x07, 0x00, 0x00, 0x00, 0x02, 0x00, 0x00, 0x00
};

const unsigned char epd_bitmap_down_left[] PROGMEM = {
	0x00, 0x00, 0x00, 0x40, 0x00, 0x00, 0x00, 0xe0, 0x00, 0x00, 0x01, 0xf0, 0x7f, 0x80, 0x03, 0xf8, 
	0x7f, 0x80, 0x07, 0xfc, 0x7f, 0x80, 0x0f, 0xfe, 0x7f, 0x80, 0x1f, 0xfc, 0x7f, 0x80, 0x3f, 0xf8, 
	0x7f, 0x80, 0x7f, 0xf0, 0x7f, 0x80, 0xff, 0xe0, 0x7f, 0x81, 0xff, 0xc0, 0x7f, 0x83, 0xff, 0x80, 
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	0x7f, 0xff, 0xff, 0xf0, 0x7f, 0xff, 0xff, 0xf0
};

const unsigned char epd_bitmap_down_right[] PROGMEM = {
	0x02, 0x00, 0x00, 0x00, 0x07, 0x00, 0x00, 0x00, 0x0f, 0x80, 0x00, 0x00, 0x1f, 0xc0, 0x01, 0xfe, 
	0x3f, 0xe0, 0x01, 0xfe, 0x7f, 0xf0, 0x01, 0xfe, 0x3f, 0xf8, 0x01, 0xfe, 0x1f, 0xfc, 0x01, 0xfe, 
	0x0f, 0xfe, 0x01, 0xfe, 0x07, 0xff, 0x01, 0xfe, 0x03, 0xff, 0x81, 0xfe, 0x01, 0xff, 0xc1, 0xfe, 
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	0x0f, 0xff, 0xff, 0xfe, 0x0f, 0xff, 0xff, 0xfe
};

const unsigned char epd_bitmap_direction_none[] PROGMEM = {
	0x00, 0x00, 0x00, 0x00, 0x00, 0x1f, 0xf8, 0x00, 0x00, 0x3f, 0xfc, 0x00, 0x00, 0x7f, 0xfe, 0x00, 
	0x00, 0xff, 0xff, 0x00, 0x00, 0xfc, 0x3f, 0x00, 0x01, 0xf8, 0x1f, 0x00, 0x01, 0xf0, 0x1f, 0x80, 
	0x00, 0x00, 0x1f, 0x80, 0x00, 0x00, 0x1f, 0x00, 0x00, 0x00, 0x3f, 0x00, 0x00, 0x00, 0x7f, 0x00, 
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	0x00, 0x07, 0x80, 0x00, 0x00, 0x00, 0x00, 0x00
};

// =================== GLOBAL VARIABLES & STATE ===================
struct DeviceState {
  const char* name;
  float distance = -1.0;
  int heading = -1;
  unsigned long last_seen = 0;
  bool sos_active = false;
};
DeviceState d3_state = {"D3", -1.0, -1, 0, false};
DeviceState self_state = {"D4", 0.0, 0, 1, false};
int hed;
int dir[10] = {0,0,0,0,0,0,0,0,0,0};
int myHeading = 0;
bool mySosActive = false;
volatile bool warningReceived = false;
const float DISTANCE_THRESHOLD = 8.0;

// --- Timers ---
unsigned long lastSendTime = 0;
const unsigned long sendInterval = 1000;
unsigned long lastDisplayUpdateTime = 0;
const unsigned long displayUpdateInterval = 100;

// =================== UNIFIED ALERT STATE MACHINE ===================
bool alertActive = false;
unsigned long alertStartMillis = 0;
unsigned long alertDuration = 0;
unsigned long lastVibeToggle = 0;
unsigned long lastLedToggle = 0;
int vibePulseOnTime = 0;
int vibePulseOffTime = 0;
int ledPulseOnTime = 0;
int ledPulseOffTime = 0;
bool vibePulseState = false;
bool ledPulseState = false;
bool showingD1Alert = false;

// =================== FUNCTION PROTOTYPES ===================
void updateDisplay();
void drawSOSOverlay(const char* text, bool sending);
void drawRangeWarning(const char* title, float distance);
void drawPeerBox(int16_t x, int16_t y, int16_t w, int16_t h, const DeviceState &p);
const unsigned char* getArrowBitmap(float angle);
float normalizeAngle(float diff);
void triggerAlert(unsigned long duration, int vibeOn, int vibeOff, int ledOn, int ledOff);
void handleAlerts();
int readCompassHeading();
void connectToWiFi();
void handleIncomingData();
void sendDataToMaster();

// =================== SETUP ===================
void setup() {
  Serial.begin(115200);
  Wire.begin(I2C_SDA, I2C_SCL);

  compass.init();
  pinMode(BUTTON_PIN, INPUT_PULLUP); // Button connected to GND
  pinMode(VIBRATION_MOTOR_PIN, OUTPUT);
  pinMode(LED_PIN, OUTPUT);
  digitalWrite(VIBRATION_MOTOR_PIN, LOW);
  digitalWrite(LED_PIN, LOW);

  // Initialize SPI OLED
  if (!display.begin(SSD1306_SWITCHCAPVCC)) {
    Serial.println(F("D4: SSD1306 allocation failed"));
    for (;;);
  }
  display.clearDisplay();
  display.drawBitmap(0, 0, logo_bitmap, 128, 64, SSD1306_WHITE);
  display.display();
  delay(2000);

  D1_SERVER_IP.fromString("192.168.4.1");
  connectToWiFi();
  my_server.begin();
  Serial.println("D4: Ready");
}

// =================== MAIN LOOP ===================
void loop() {
  handleIncomingData();

  if (warningReceived) {
    Serial.println("[D4] Warning received!");
    showingD1Alert = true;
    triggerAlert(3000, 300, 100, 150, 150);
    warningReceived = false;
  }
  
  handleAlerts();

  // Periodic uplink
  if (millis() - lastSendTime > sendInterval) {
    mySosActive = (digitalRead(BUTTON_PIN) == LOW); // LOW means pressed
    self_state.sos_active = mySosActive;
    if (mySosActive) {
      Serial.println("[D4] SOS ACTIVE!");
      triggerAlert(2000, 200, 200, 2000, 0);
    }

    myHeading = readCompassHeading();
    self_state.heading = myHeading;
    self_state.last_seen = millis();
    Serial.print("D4 Heading: "); Serial.println(myHeading);
    
    sendDataToMaster();
    lastSendTime = millis();
  }
  
  if (WiFi.status() != WL_CONNECTED) {
    connectToWiFi();
  }

  if (millis() - lastDisplayUpdateTime > displayUpdateInterval) {
    updateDisplay();
    lastDisplayUpdateTime = millis();
  }
}

// =================== CONTROL & HELPER FUNCTIONS ===================
void triggerAlert(unsigned long duration, int vibeOn, int vibeOff, int ledOn, int ledOff) {
    alertActive = true;
    alertStartMillis = millis();
    alertDuration = duration;
    vibePulseOnTime = vibeOn;
    vibePulseOffTime = vibeOff;
    ledPulseOnTime = ledOn;
    ledPulseOffTime = ledOff;
    vibePulseState = (vibeOn > 0);
    ledPulseState = (ledOn > 0);
    digitalWrite(VIBRATION_MOTOR_PIN, vibePulseState ? HIGH : LOW);
    digitalWrite(LED_PIN, ledPulseState ? HIGH : LOW);
    lastVibeToggle = millis();
    lastLedToggle = millis();
}

void handleAlerts() {
    if (!alertActive) {
        digitalWrite(VIBRATION_MOTOR_PIN, LOW);
        digitalWrite(LED_PIN, LOW);
        showingD1Alert = false;
        return;
    }

    if (millis() - alertStartMillis > alertDuration) {
        alertActive = false;
        digitalWrite(VIBRATION_MOTOR_PIN, LOW);
        digitalWrite(LED_PIN, LOW);
        showingD1Alert = false;
        return;
    }

    if (vibePulseOnTime > 0 && vibePulseOffTime > 0) {
        unsigned long interval = vibePulseState ? vibePulseOnTime : vibePulseOffTime;
        if (millis() - lastVibeToggle >= interval) {
            vibePulseState = !vibePulseState;
            digitalWrite(VIBRATION_MOTOR_PIN, vibePulseState ? HIGH : LOW);
            lastVibeToggle = millis();
        }
    } else {
        digitalWrite(VIBRATION_MOTOR_PIN, vibePulseOnTime > 0 ? HIGH : LOW);
    }

    if (ledPulseOnTime > 0 && ledPulseOffTime > 0) {
        unsigned long interval = ledPulseState ? ledPulseOnTime : ledPulseOffTime;
        if (millis() - lastLedToggle >= interval) {
            ledPulseState = !ledPulseState;
            digitalWrite(LED_PIN, ledPulseState ? HIGH : LOW);
            lastLedToggle = millis();
        }
    } else {
        digitalWrite(LED_PIN, ledPulseOnTime > 0 ? HIGH : LOW);
    }
}

int readCompassHeading() {
    hed = 0;
    compass.read();
    for (int i = 0; i <= 9; ++i) {
      dir[i] = compass.getAzimuth();
      hed += dir[i];
    }
    return hed / 10;
}

float normalizeAngle(float diff) {
    diff = fmod(diff, 360.0);
    if (diff > 180.0) diff -= 360.0;
    else if (diff < -180.0) diff += 360.0;
    return diff;
}

const unsigned char* getArrowBitmap(float angle) {
  if (angle >= -22.5 && angle < 22.5) return epd_bitmap_up;
  if (angle >= 22.5 && angle < 67.5) return epd_bitmap_up_right;
  if (angle >= 67.5 && angle < 112.5) return epd_bitmap_right;
  if (angle >= 112.5 && angle < 157.5) return epd_bitmap_down_right;
  if (angle >= 157.5 || angle < -157.5) return epd_bitmap_down;
  if (angle >= -157.5 && angle < -112.5) return epd_bitmap_down_left;
  if (angle >= -112.5 && angle < -67.5) return epd_bitmap_left;
  if (angle >= -67.5 && angle < -22.5) return epd_bitmap_up_left;
  return epd_bitmap_direction_none;
}

// =================== NETWORK FUNCTIONS ===================
void connectToWiFi() {
  display.clearDisplay();
  display.setTextColor(SSD1306_WHITE);
  display.setTextSize(1);
  display.setCursor(0, 0);
  display.println("Connecting to WiFi...");
  display.display();
  Serial.print("Connecting to "); Serial.println(ssid);

  WiFi.begin(ssid, password);
  unsigned long startAttemptTime = millis();
  while (WiFi.status() != WL_CONNECTED) {
    delay(500);
    Serial.print(".");
    if (millis() - startAttemptTime > 10000) {
        Serial.println(" Connection Failed.");
        break;
    }
  }
  
  if (WiFi.status() == WL_CONNECTED) {
    Serial.println("\nWiFi Connected.");
    Serial.print("D4 IP address: "); Serial.println(WiFi.localIP());
  }
}

void handleIncomingData() {
  WiFiClient client = my_server.available();
  if (client) {
    String data = client.readStringUntil('\n');
    client.stop();
    data.trim();
    
    Serial.print("D4 Received Data: "); Serial.println(data);

    if (data == "WARN") {
      warningReceived = true;
    } else if (data.startsWith("D3_DATA")) {
      char data_cstr[64];
      data.toCharArray(data_cstr, 64);
      char* token = strtok(data_cstr, ","); 
      
      token = strtok(NULL, ","); if(token) d3_state.heading = atoi(token);
      token = strtok(NULL, ","); if(token) d3_state.distance = atof(token);
      bool previousD3Sos = d3_state.sos_active;
      token = strtok(NULL, ","); if(token) d3_state.sos_active = (bool)atoi(token);
      if (!previousD3Sos && d3_state.sos_active) {
        triggerAlert(3000, 300, 100, 100, 100);
      }
      token = strtok(NULL, ","); if(token) {
        d3_state.last_seen = (atoi(token) == 1) ? millis() : 0;
      }
    }
  }
}

void sendDataToMaster() {
  WiFiClient client;
  if (!client.connect(D1_SERVER_IP, D1_SERVER_PORT)) {
    Serial.println("Connection to D1 master failed!");
    if (mySosActive) {
        drawSOSOverlay("FAILED", false);
        display.display();
        delay(1500);
    }
    return;
  }
  
  if (mySosActive) {
      drawSOSOverlay("SENDING", false);
      display.display();
  }

  long rssi = WiFi.RSSI();
  char dataPacket[64];
  snprintf(dataPacket, sizeof(dataPacket), "%s,%d,%d,%ld", DEVICE_NAME, myHeading, mySosActive ? 1 : 0, rssi);
  client.println(dataPacket);
  client.stop();
  Serial.print("Sent data: "); Serial.println(dataPacket);
}

// =================== DISPLAY FUNCTIONS ===================
void updateDisplay() {
    display.clearDisplay();
    display.setTextColor(SSD1306_WHITE);

    if (showingD1Alert && !mySosActive) {
        drawRangeWarning("D1 ALERT", -1);
        display.display();
        return;
    }

    if (mySosActive || d3_state.sos_active) {
        if (mySosActive && d3_state.sos_active) drawSOSOverlay("SOS ALL", true);
        else if (mySosActive) drawSOSOverlay("SOS", true);
        else drawSOSOverlay("SOS D3", false);
        display.display();
        return;
    }

    if (d3_state.distance > DISTANCE_THRESHOLD && d3_state.last_seen > 0) {
        drawRangeWarning("D3 OUT RANGE", d3_state.distance);
        display.display();
        return;
    }
    
    display.drawRect(0, 0, SCREEN_WIDTH, SCREEN_HEIGHT, SSD1306_WHITE);
    display.drawLine(SCREEN_WIDTH/2, 0, SCREEN_WIDTH/2, SCREEN_HEIGHT, SSD1306_WHITE);

    const int16_t margin = 1;
    const int16_t midX = SCREEN_WIDTH / 2;
    const int16_t boxW = (SCREEN_WIDTH / 2) - 2 * margin;
    const int16_t boxH = SCREEN_HEIGHT - 2 * margin;

    drawPeerBox(margin, margin, boxW, boxH, d3_state);
    drawPeerBox(midX + margin, margin, boxW, boxH, self_state);
    display.display();
}

void drawPeerBox(int16_t x, int16_t y, int16_t w, int16_t h, const DeviceState &p) {
    if (millis() - p.last_seen > 5000) {
        display.setTextSize(1);
        display.setCursor(x + 5, y + 28);
        display.println("No Signal");
        return;
    }

    const uint8_t nameSize = 1;
    const uint8_t distSize = 1;
    const int16_t nameH = 8 * nameSize;
    const int16_t arrowH = 30;
    const int16_t space1 = 4;
    const int16_t space2 = 4;
    int16_t totalH = nameH + space1 + arrowH + space2 + (8 * distSize);
    int16_t y0 = y + (h - totalH) / 2;

    display.setTextSize(nameSize);
    int16_t nameW = strlen(p.name) * 6 * nameSize;
    display.setCursor(x + (w - nameW) / 2, y0);
    display.print(p.name);

    float diff = normalizeAngle(p.heading - myHeading);
    const unsigned char* arrowBitmap = getArrowBitmap(diff);
    int16_t arrowX = x + (w - 32) / 2;
    int16_t arrowY = y0 + nameH + space1;
    display.drawBitmap(arrowX, arrowY, arrowBitmap, 32, 30, SSD1306_WHITE);

    char buf[8];
    dtostrf(p.distance, 3, 1, buf);
    display.setTextSize(distSize);
    int16_t distW = strlen(buf) * 6 * distSize + 6;
    int16_t distX = x + (w - distW) / 2;
    int16_t distY = arrowY + arrowH + space2;
    display.setCursor(distX, distY);
    display.print(buf);
    display.print("m");
}

void drawSOSOverlay(const char* text, bool sending) {
    display.setTextSize(3);
    if ((millis() / 800) % 2) {
        int16_t x1, y1;
        uint16_t w, h;
        display.getTextBounds(text, 0, 0, &x1, &y1, &w, &h);
        display.setCursor((SCREEN_WIDTH - w) / 2, 10);
        display.print(text);
    }
    if (sending) {
      display.setTextSize(1);
      display.setCursor(27, 50);
      display.print("Sending Alert");
    }
    display.drawRect(0, 0, SCREEN_WIDTH, SCREEN_HEIGHT, SSD1306_WHITE);
}

void drawRangeWarning(const char* title, float distance) {
  const int T_SIZE = 30;
  int cX = SCREEN_WIDTH / 2;
  int tTop = 5;
  display.drawTriangle(cX, tTop, cX - T_SIZE / 2, tTop + T_SIZE, cX + T_SIZE / 2, tTop + T_SIZE, SSD1306_WHITE);
  const int E_H = 12; const int E_W = 4;
  int eY = tTop + T_SIZE / 3;
  display.fillRect(cX - E_W / 2, eY, E_W, E_H, SSD1306_BLACK);
  display.fillRect(cX - E_W / 2, eY + E_H + 3, E_W, E_W, SSD1306_BLACK);
  
  display.setTextSize(2);
  display.setCursor(5, tTop + T_SIZE + 5);
  display.println(title);

  if (distance >= 0) {
      display.setTextSize(1);
      display.setCursor(35, tTop + T_SIZE + 25);
      display.printf("%.1f meters", distance);
  }
}
